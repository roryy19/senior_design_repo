## firmware/esp/sdkconfig.defaults
```kconfig
# Enable Bluetooth (NimBLE stack — lighter than BlueDroid)
CONFIG_BT_ENABLED=y
CONFIG_BT_NIMBLE_ENABLED=y
CONFIG_BT_NIMBLE_MAX_CONNECTIONS=1

# Disable BlueDroid (we use NimBLE instead)
CONFIG_BT_BLUEDROID_ENABLED=n

# Enable observer role (scanning for beacons)
CONFIG_BT_NIMBLE_ROLE_OBSERVER=y

# Set the device name that appears during scanning
CONFIG_BT_NIMBLE_SVC_GAP_DEVICE_NAME="ObstacleBelt"

# Custom partition table with SPIFFS for audio clip storage
CONFIG_PARTITION_TABLE_CUSTOM=y
CONFIG_PARTITION_TABLE_CUSTOM_FILENAME="partitions.csv"

# Flash size — ESP32-S3-DevKitC-1 has 16MB
CONFIG_ESPTOOLPY_FLASHSIZE_16MB=y

# Suppress noisy NimBLE stack logs (only show warnings+errors)
CONFIG_BT_NIMBLE_LOG_LEVEL_WARNING=y
```
